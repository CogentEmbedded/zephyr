## dts/bindings/pwm/litex,pwm.yaml
```yaml
#
# Copyright (c) 2019 Antmicro <www.antmicro.com>
#
# SPDX-License-Identifier: Apache-2.0
#

description: LiteX PWM controller

include: [pwm-controller.yaml, base.yaml]

compatible: "litex,pwm"

properties:
    reg:
      required: true

    "#pwm-cells":
      const: 2

    # Do not disable PWM when adjusting period or duty cycle
    "no-glitch":
      type: boolean
      required: false

pwm-cells:
  - channel
  - period
```
